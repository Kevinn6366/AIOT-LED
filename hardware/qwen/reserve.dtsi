/ {
    reserved-memory {
        #address-cells = <1>;
        #size-cells = <1>;
        ranges;
        qwen@20000000 {
            reg = <0x20000000 0x1b000000>;
            no-map;
        };
    };
};
